## main/Kconfig.projbuild
```kconfig
menu "ESP32 Controller - General configuration"
    config ECTRL_FIRMWARE_VERSION
        string "Firmware version"
        default "0.1.0"
        help
            This is the firmware version.
endmenu

menu "ESP32 Controller - Storage configuration"
    config VFAT_VOLUME_NAME
        string "Data storage partition name"
        default "data"
        help
            This is the name of the partition on which data is stored. Its type must be FAT.
    
    config NVS_VOLUME_NAME
        string "Configuration storage partition name"
        default "config"
        help
            This is the name of the partition on which config is stored. Its type must be NVS.
    
    config MAX_VFAT_PATH_LENGTH
        int "Maximum FAT path length"
        range 64 2048
        default 512
        help
            Defines maximum path length for file paths on FAT partitions.
endmenu

menu "ESP32 Controller - UART configuration"

    config UART_EVENT_STACK_SIZE
        int "Stack size for UART event task"
        range 1024 16384
        default 8192
        help
            Defines stack size for event loop, in bytes. Set it high enough to prevent stack overflow.
    
    config UART_BUF_SIZE
        int "UART buffer size"
        range 1024 16384
        default 1024
        help
            Defines UART buffer size, in bytes.
endmenu

menu "ESP32 Controller - Screen configuration"

    config PIN_TFT_RESX
        int "Reset pin"
        range 0 39
        default 4
        help
            Sets GPIO pin number for TFT reset.
    
    config PIN_TFT_CSX
        int "SPI Chip Select pin"
        range 0 39
        default 15
        help
            Sets GPIO pin number for SPI chip select.

    config PIN_TFT_SDO
        int "SPI MISO pin"
        range 0 39
        default 12
        help
            Sets GPIO pin number for SPI MISO.

    config PIN_TFT_SDA
        int "SPI MOSI pin"
        range 0 39
        default 13
        help
            Sets GPIO pin number for SPI MOSI.

    config PIN_TFT_DCX
        int "SPI clock pin"
        range 0 39
        default 14
        help
            Sets GPIO pin number for SPI clock.

    config PIN_TFT_WRX
        int "TFT data/command selection pin"
        range 0 39
        default 5
        help
            Sets GPIO pin number for TFT data/command selection pin.

    config PIN_TFT_BKLT
        int "TFT backlight control pin"
        range 0 39
        default 19
        help
            Sets GPIO pin number for TFT backlight dimming pin.
    
    choice SPI_CLOCK
        bool "SPI clock frequency"
        default SPICLK_10MHZ
        help
            Sets SPI clock frequency.
        
        config SPICLK_1MHZ
            bool "1 MHz"
        config SPICLK_2MHZ
            bool "2 MHz"
        config SPICLK_4MHZ
            bool "4 MHz"
        config SPICLK_8MHZ
            bool "8 MHz"
        config SPICLK_10MHZ
            bool "10 MHz"
        config SPICLK_20MHz
            bool "20 MHz"
        config SPICLK_40MHZ
            bool "40 MHz"
        config SPICLK_80MHZ
            bool "80 MHz"
    endchoice

    config SPI_MAX_TRANSFER_SIZE
        int "SPI maximum transfer size"
        range 20 16384
        default 6400
        help
            Defines maximum size of single SPI transfer, in bytes.

    config SPI_QUEUE_LENGTH
        int "SPI queue length"
        range 1 65535
        default 2
        help
            Defines SPI queue length (number of buffers that can be prepared before batch send).

    config SPI_CLOCK
        int
        default 1000000 if SPICLK_1MHZ
        default 2000000 if SPICLK_2MHZ
        default 4000000 if SPICLK_4MHZ
        default 8000000 if SPICLK_8MHZ
        default 10000000 if SPICLK_10MHZ
        default 20000000 if SPICLK_20MHZ
        default 40000000 if SPICLK_40MHZ
        default 80000000 if SPICLK_80MHZ
    
    config TFT_SCREEN_WIDTH
        int "Screen width"
        range 32 6400
        default 320
        help
            Screen width in pixels
    
    config TFT_SCREEN_HEIGHT
        int "Screen height"
        range 32 6400
        default 240
        help
            Screen height in pixels

    choice COLOR_FORMAT
        bool "TFT color format"
        default ST7789VI_COLMOD_CTRL_12BIT
        help
            Sets TFT color format.
        
        config ST7789VI_COLMOD_CTRL_12BIT
            bool "12 bit"
        config ST7789VI_COLMOD_CTRL_16BIT
            bool "16 bit"
        config ST7789VI_COLMOD_CTRL_18BIT
            bool "18 bit"
        config ST7789VI_COLMOD_CTRL_24BIT
            bool "24 bit"
    
    endchoice
    config COLOR_FORMAT
        int
        default 3 if ST7789VI_COLMOD_CTRL_12BIT
        default 5 if ST7789VI_COLMOD_CTRL_16BIT
        default 6 if ST7789VI_COLMOD_CTRL_18BIT
        
endmenu

menu "ESP32 Controller - Touch panel configuration"

    config PIN_TOUCH_XL
        int "Touch panel XL pin"
        range 0 39
        default 33
        help
            Sets GPIO pin number for touch panel XL pin.

    config PIN_TOUCH_XR
        int "Touch panel XR pin"
        range 0 39
        default 26
        help
            Sets GPIO pin number for touch panel XR pin.

    config PIN_TOUCH_YD
        int "Touch panel YD pin"
        range 0 39
        default 32
        help
            Sets GPIO pin number for touch panel YD pin.

    config PIN_TOUCH_YU
        int "Touch panel YU pin"
        range 0 39
        default 25
        help
            Sets GPIO pin number for touch panel YU pin.
    
    config TOUCH_TRIG_PRESSURE
        int "Touch pressure level triggering an event"
        range 0 1023
        default 250
        help
            Screen height in pixels

    choice TOUCH_USE_INTERRUPT
        bool "Touch reading uses interrupt"
        default TOUCH_NO_INT
        help
            If set to yes, touch events are read using an interrupt;
            If set to no, touch events are read by polling touch pressure.
            Using interrupt is faster but doesn't permit drag events.
        
        config TOUCH_NO_INT
            bool "No"
        config TOUCH_WITH_INT
            bool "Yes"
    endchoice
        
endmenu

menu "ESP32 Controller - GPIO pins configuration"
    config PIN_POT_1
        int "Physical pin for potentiometer 1"
        range 0 39
        default 35
        help
            Tells on which pin to read potentiometer 1.

    config PIN_POT_2
        int "Physical pin for potentiometer 2"
        range 0 39
        default 36
        help
            Tells on which pin to read potentiometer 2.
    
    config PIN_BATT_MON
        int "Physical pin for battery monitoring"
        range 0 39
        default 39
        help
            Tells on which pin to read battery level.
    
    config PIN_BATT_CHRG
        int "Physical pin for battery charger state"
        range 0 39
        default 21
        help
            Tells on which pin to read battery charger state.
endmenu

menu "ESP32 Controller - Network configuration"
    config WIFI_SSID
        string "WiFi SSID"
        default ""
        help
            SSID of WiFi network to connect to.

    config WIFI_PASSWORD
        string "WiFi password"
        default ""
        help
            Password for WiFi network to connect to.
    
    config WIFI_MAX_RETRIES
        int "Maximum number of connection retries for WiFi"
        range 0 65535
        default 9999
        help
            Maximum number of connection retries if WiFi connection fails or is lost.
    
    config WEBSOCKET_HOST
        string "WebSocket host name or IP address"
        default ""
        help
            Host name or IP address of WebSocket host to connect to.

    config WEBSOCKET_PORT
        int "WebSocket host port"
        range 0 65535
        default 4455
        help
            Port of WebSocket host to connect to.
    
    config WEBSOCKET_PATH
        string "WebSocket path"
        default "/"
        help
            Path on WebSocket host.
            
    config WEBSOCKET_PASSWORD
        string "WebSocket password"
        default ""
        help
            Password to connect to obs-websocket server.
    
    config WEBSOCKET_BUF_SIZE
        int "WebSocket buffer size"
        range 1024 16384
        default 1024
        help
            Buffer size for WebSocket client.
        
    config WEBSOCKET_POLL_RATE_MS
        int "WebSocket polling rate"
        range 5 1000
        default 10
        help
            Polling rate for WebSocket client, in ms.

endmenu
```

## sdkconfig.defaults
```kconfig
#
# Bootloader config
#
CONFIG_BOOTLOADER_LOG_LEVEL_ERROR=y
CONFIG_ESPTOOLPY_FLASHSIZE_DETECT=y

#
# Partition Table
#
CONFIG_PARTITION_TABLE_CUSTOM=y
CONFIG_PARTITION_TABLE_CUSTOM_FILENAME="partitions.csv"
CONFIG_PARTITION_TABLE_FILENAME="partitions.csv"
CONFIG_PARTITION_TABLE_OFFSET=0x8000
CONFIG_PARTITION_TABLE_MD5=y

#
# Compiler options
#
CONFIG_COMPILER_OPTIMIZATION_SIZE=y
CONFIG_COMPILER_OPTIMIZATION_ASSERTIONS_ENABLE=y
CONFIG_COMPILER_OPTIMIZATION_ASSERTION_LEVEL=2
CONFIG_COMPILER_HIDE_PATHS_MACROS=y
CONFIG_COMPILER_CXX_EXCEPTIONS=y
CONFIG_COMPILER_CXX_EXCEPTIONS_EMG_POOL_SIZE=1024
CONFIG_COMPILER_CXX_RTTI=y
CONFIG_COMPILER_STACK_CHECK_MODE_NONE=y

#
# ADC configuration
#
CONFIG_ADC_DISABLE_DAC=y

#
# SPI configuration
#
CONFIG_SPI_MASTER_ISR_IN_IRAM=y
CONFIG_SPI_SLAVE_ISR_IN_IRAM=y

#
# ESP-TLS
#
CONFIG_ESP_TLS_USING_MBEDTLS=y

#
# SPI RAM config
#
CONFIG_SPIRAM_TYPE_AUTO=y
CONFIG_SPIRAM_SIZE=-1
CONFIG_SPIRAM_SPEED_80M=y
CONFIG_SPIRAM=y
CONFIG_SPIRAM_BOOT_INIT=y
CONFIG_SPIRAM_USE_MALLOC=y
CONFIG_SPIRAM_MEMTEST=y


#
# Event Loop Library
#
CONFIG_ESP_EVENT_POST_FROM_ISR=y
CONFIG_ESP_EVENT_POST_FROM_IRAM_ISR=y

#
# Wi-Fi
#
CONFIG_ESP32_WIFI_ENABLED=y
CONFIG_ESP32_WIFI_STATIC_RX_BUFFER_NUM=5
CONFIG_ESP32_WIFI_STATIC_TX_BUFFER_NUM=5

#
# FAT Filesystem support
#
CONFIG_FATFS_MAX_LFN=255
CONFIG_FATFS_LFN_HEAP=y

#
# Log output
#
CONFIG_LOG_DEFAULT_LEVEL_ERROR=y
CONFIG_LOG_DEFAULT_LEVEL=1
CONFIG_LOG_MAXIMUM_LEVEL_VERBOSE=y
CONFIG_LOG_MAXIMUM_LEVEL=5

#
# mbedTLS
#
CONFIG_MBEDTLS_INTERNAL_MEM_ALLOC=y
CONFIG_MBEDTLS_HARDWARE_SHA=y
CONFIG_MBEDTLS_HAVE_TIME=y
CONFIG_MBEDTLS_TLS_ENABLED=y

#
# PThreads
#
CONFIG_PTHREAD_TASK_STACK_SIZE_DEFAULT=8192

#
# Websocket
#
CONFIG_WS_TRANSPORT=y
CONFIG_WS_BUFFER_SIZE=1024

#
# Virtual file system
#
CONFIG_VFS_SUPPORT_IO=y
CONFIG_VFS_SUPPORT_DIR=y

#
# Wear Levelling
#
CONFIG_WL_SECTOR_SIZE_4096=y
CONFIG_WL_SECTOR_SIZE=4096

#
# Supplicant
#
CONFIG_WPA_MBEDTLS_CRYPTO=y

#
# LVGL configuration
#
CONFIG_LV_CONF_SKIP=y

#
# LVGL: Color settings
#
CONFIG_LV_COLOR_DEPTH_32=y
CONFIG_LV_COLOR_DEPTH=32

#
# LVGL: Memory settings
#
CONFIG_LV_MEM_SIZE_KILOBYTES=32
CONFIG_LV_MEM_BUF_MAX_NUM=16

#
# LVGL: Drawing
#
CONFIG_LV_DRAW_COMPLEX=y

#
# LVGL: Asserts
#
CONFIG_LV_USE_ASSERT_NULL=y
CONFIG_LV_USE_ASSERT_MALLOC=y
CONFIG_LV_USE_ASSERT_STYLE=y

#
# Others
#
CONFIG_LV_USE_USER_DATA=y

#
# Compiler settings
#
CONFIG_LV_ATTRIBUTE_FAST_MEM_USE_IRAM=y

#
# Widget usage
#
CONFIG_LV_USE_BAR=y
CONFIG_LV_USE_BTN=y
CONFIG_LV_USE_IMG=y
CONFIG_LV_USE_LABEL=y
CONFIG_LV_USE_LINE=y

#
# Extra Widgets
#
CONFIG_LV_USE_IMGBTN=y
```
